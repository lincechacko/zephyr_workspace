## blink_led/build/Kconfig/boards/Kconfig.defconfig
```kconfig
# Load Zephyr board defconfig descriptions.
osource "C:/Users/Lince/zephyr_project/zephyrproject/zephyr/boards/st/nucleo_l152re/Kconfig.defconfig"
```

## uart_polling/build/Kconfig/boards/Kconfig
```kconfig
# Load Zephyr board Kconfig descriptions.
osource "C:/Users/Lince/zephyr_project/zephyrproject/zephyr/boards/st/nucleo_g071rb/Kconfig"
```

## uart_polling/build/Kconfig/boards/Kconfig.defconfig
```kconfig
# Load Zephyr board defconfig descriptions.
osource "C:/Users/Lince/zephyr_project/zephyrproject/zephyr/boards/st/nucleo_g071rb/Kconfig.defconfig"
```

## uart_polling/build/Kconfig/boards/Kconfig.nucleo_l152re
```kconfig
# Load board Kconfig descriptions.
osource "C:/Users/Lince/zephyr_project/zephyrproject/zephyr/boards/st/nucleo_l152re/Kconfig.nucleo_l152re"
```

## uart_polling/build/Kconfig/boards/Kconfig.sysbuild
```kconfig
# Load Sysbuild board Kconfig descriptions.
osource "C:/Users/Lince/zephyr_project/zephyrproject/zephyr/boards/st/nucleo_l152re/Kconfig.sysbuild"
```
